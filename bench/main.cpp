// bench_board.h before hw/board.h: the generated header carries the
// BENCH_BOARD_PATCH_SM define board.h switches on, and Make gives it a real
// dependency edge onto this object (bench/Makefile, "board header").
#include "bench_board.h"
#include "hw/board.h"
#include "report.h"
#include "workload.h"
#include "families.h"
#include "cycles.h"
#include "qspi_digest.h"
#include "rand_shim.h"
#include "synth/wt_bank.h"
#include "bench_transport.h"

namespace bench { void run_anchors(Board& hw); }

// Generated by bench/Makefile (see the git-hash-header rule below the
// libDaisy `include`) with a real prerequisite edge onto this translation
// unit, so a HEAD move actually forces a rebuild instead of leaving a
// stale hash baked into an untouched object file.
#include "git_hash.h"

#ifndef BENCH_GIT_HASH
#define BENCH_GIT_HASH "unknown"
#endif

static bench::Board hw;

int main(void)
{
    // Clocks, caches, SDRAM and the audio format, plus the boot_info stamp
    // without which the first SDRAM access HardFaults. All of it, and the
    // reasoning behind the stamp, lives in src/hw/board.h -- it is the one
    // thing that genuinely differs between the two boards, and the shipping
    // firmware needs the same sequence.
    bench::board_init(hw);

    // The bench's DTCM NOLOAD state survives reset and is not covered by the
    // startup handler's AXI _sbss.._ebss clear. Seed through the C entry point
    // before any DaisySP workload so retained RAM cannot affect the run.
    ::srand(1u);

    // On the semihosting branch this does nothing, for the reason it always
    // did: those writes are synchronous through the probe, so the first line
    // cannot be lost to enumeration timing. On the USB branch it blocks until
    // the host opens the port -- which is exactly the handshake semihosting
    // never needed.
    bench::transport_open();

    bench::cycles_init();

    char qspi_sha256[65];
    bench::sha256_hex(
        reinterpret_cast<const volatile uint8_t*>(spky::wt::kBankSamples),
        sizeof(spky::wt::kBankSamples),
        qspi_sha256);
    bench::report_begin(BENCH_GIT_HASH, qspi_sha256, bench::families_csv());
    for (int f = 0; f < bench::kFamilyCount; ++f) {
        const bench::Family& fam = bench::kFamilies[f];
        for (int i = 0; i < fam.count; ++i) {
            const bench::Workload& w = fam.rows[i];
            bench::report_row(w, bench::run_workload(w));
        }
    }

    // Offline is optimistic: no cache/DMA contention from a live audio
    // engine sharing the bus. Three rows re-run inside a real callback to
    // calibrate that offset -- and audibly. NOTE what this actually
    // calibrates: anchor.cpp's AnchorCallback calls CpuLoadMeter::OnBlockStart()
    // *after* the ISR prologue and dispatch already ran, so the anchored
    // figures capture cache and DMA contention only, not the ISR/dispatch
    // overhead itself. That gap makes the anchored numbers conservative
    // (an understatement of true in-callback cost), which is why they never
    // move the "does not fit" conclusion in the wrong direction.
    bench::run_anchors(hw);

    bench::report_end();

#if defined(BENCH_TRANSPORT_USB)
    // Without this jump every second repeat needs a hand at the board:
    // dfu-util wants a device already in DFU mode, and there is no probe
    // here to reset one into it. Far outside any measured window --
    // BENCH_END is already out.
    //
    // DAISY_INFINITE_TIMEOUT, not DAISY: the plain mode gives the
    // bootloader its normal few-second window and then boots the app
    // again, which turns a slow host into a lost run. Infinite waits for
    // dfu-util however long it takes. The consequence is deliberate and
    // worth stating: the board then stays in the bootloader until
    // something programs it. That is recoverable with dfu-util and
    // nothing else is needed.
    daisy::System::Delay(100);          // let the line drain
    daisy::System::ResetToBootloader(
        daisy::System::BootloaderMode::DAISY_INFINITE_TIMEOUT);
#endif

    // The idle loop, after everything measured and everything reported. The
    // submodule has no DelayMs (DaisySeed's is `system.Delay(del)` and
    // nothing else, daisy_seed.cpp:166), so it needs a different spelling --
    // and per the plan that difference comes out HERE, not as a line in
    // board.h that starts emulating peripherals.
    //
    // Why the Seed branch is not simply switched to the portable spelling
    // too, which would read better: it is four bytes shorter, and those four
    // bytes shift every symbol behind main() by eight. Measured 2026-08-08 --
    // 100951 bytes of the SRAM image move, all of it relocation, none of it
    // semantics. Harmless in principle; but execution layout is something
    // this bench MEASURES (see BENCH_ITCM_HOT), so "harmless" is not a claim
    // to make for free. Kept bit-for-bit, and the Seed image is therefore
    // byte-identical across this whole refactor -- which is what makes the
    // Seed vs patch_sm comparison a board comparison and nothing else.
#if defined(BENCH_BOARD_PATCH_SM)
    while (1) { hw.Delay(1000); }
#else
    while (1) { hw.DelayMs(1000); }
#endif
}
